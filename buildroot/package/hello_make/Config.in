## buildroot/package/hello_make/Config.in
```kconfig
config BR2_PACKAGE_HELLO_MAKE

        bool "hello_make"
        help
          This is a comment that explains what libfoo is. The help text
          should be wrapped.

          
```

## buildroot/package/kernel_hello_irq/Config.in
```kconfig
config BR2_PACKAGE_KERNEL_HELLO_IRQ

        bool "kernel_hello_irq"
        help
          This is a kernel model? which start timer, and handles it with irq.

          https://github.com/Ultrafeel/kernel_hello_irq
```

## buildroot/package/led_switch/Config.in
```kconfig
config BR2_PACKAGE_LED_SWITCH

        bool "led_switch"
        help
          led_switch lights up led on switch press.

          
```

## opensource/u-boot/board/raspberrypi/cabanitos/Kconfig
```kconfig
if TARGET_CABANITOS

config SYS_BOARD
	default "cabanitos"

config SYS_VENDOR
	default "raspberrypi"

config SYS_SOC
	default "bcm283x"

config SYS_CONFIG_NAME
	default "cabanitos"

endif
```

## opensource/u-boot/board/raspberrypi/rpi/Kconfig
```kconfig
if TARGET_RPI

config SYS_BOARD
        default "rpi"

config SYS_VENDOR
        default "raspberrypi"

config SYS_SOC
        default "bcm283x"

config SYS_CONFIG_NAME
        default "rpi"

endif

if TARGET_RPI_2

config SYS_BOARD
        default "rpi"

config SYS_VENDOR
        default "raspberrypi"

config SYS_SOC
        default "bcm283x"

config SYS_CONFIG_NAME
        default "rpi"

endif

if TARGET_RPI_3_32b

config SYS_BOARD
        default "rpi"

config SYS_VENDOR
        default "raspberrypi"

config SYS_SOC
        default "bcm283x"

config SYS_CONFIG_NAME
        default "rpi"

endif
```
